## Copies of local build_conf/conf/bblayers.conf
```bitbake
# POKY_BBLAYERS_CONF_VERSION is increased each time build/conf/bblayers.conf
# changes incompatibly
POKY_BBLAYERS_CONF_VERSION = "2"

BBPATH = "${TOPDIR}"
BBFILES ?= ""

BBLAYERS ?= " \
  ${HOME}/yocto/poky-warrior/meta \
  ${HOME}/yocto/poky-warrior/meta-poky \
  ${HOME}/yocto/meta-openembedded/meta-oe \
  ${HOME}/yocto/meta-openembedded/meta-networking \
  ${HOME}/yocto/meta-openembedded/meta-python \
  ${HOME}/yocto/meta-qt5 \
  ${HOME}/yocto/bbb/meta-bbb \
  ${HOME}/yocto/meta-ti \
"
```

## Copies of local build_conf/conf/local.conf
```bitbake
# Local configuration for meta-bbb images
# Yocto Project 2.7 Poky distribution [warrior] branch
# This is a sysvinit system

BBMASK = "meta-networking/recipes-kernel/wireguard"

LICENSE_FLAGS_WHITELIST = "commercial"

DISTRO_FEATURES = "ext2 opengl usbhost ${DISTRO_FEATURES_LIBC}"

# remove pulseaudio since it brings in x11
DISTRO_FEATURES_BACKFILL_CONSIDERED += "pulseaudio opengl"

PREFERRED_PROVIDER_jpeg = "libjpeg-turbo"

PREFERRED_PROVIDER_udev = "eudev"
VIRTUAL-RUNTIME_init_manager = "sysvinit"

# Default is 5.0, but you can change versions here 
#PREFERRED_VERSION_linux-stable = "4.19.%"
PREFERRED_VERSION_linux-ti-staging = "4.19.%"

#-------------------------------------------------
## Graphics section ##
#-------------------------------------------------
#PACKAGES_GFX_${MACHINE} = "omapdrm-pvr"

# Enable Gfx Pkgs
#MULTI_PROVIDER_WHITELIST += "virtual/libgl virtual/egl virtual/libgles1 virtual/libgles2"

DEPENDS_remove = "virtual/libgl"

# Preferred providers
PREFERRED_PROVIDER_virtual/libgles1 = ""
PREFERRED_PROVIDER_virtual/libgles2 = "ti-sgx-ddk-um"
PREFERRED_PROVIDER_virtual/egl      = "ti-sgx-ddk-um"
PREFERRED_PROVIDER_virtual/mesa     = "mesa-gl"
PREFERRED_PROVIDER_libgbm           = "libgbm"

#Preferred versions
#PREFERRED_VERSION_libgbm            = "10.0.0"



MACHINE = "ti33x"
#MACHINE = "beaglebone"
#DL_DIR = "${HOME}/oe-sources"
#SSTATE_DIR = "/oe7/bbb/sstate-cache"
#TMPDIR = "/oe7/bbb/tmp-warrior"

DISTRO = "poky"

PACKAGE_CLASSES = "package_ipk"

# i686 or x86_64
SDKMACHINE = "x86_64"

# for no root password
#EXTRA_IMAGE_FEATURES = "debug-tweaks"

# to enable a root password of jumpnowtek
INHERIT += "extrausers"
EXTRA_USERS_PARAMS = "usermod -P jumpnowtek root; "

# to force a password change on first login
INHERIT += "chageusers"
CHAGE_USERS_PARAMS = "chage -d0 root; "

USER_CLASSES = "image-mklibs image-prelink"

PATCHRESOLVE = "noop"
RM_OLD_IMAGE = "1"
INHERIT += "rm_work"
CONF_VERSION = "1"
```
